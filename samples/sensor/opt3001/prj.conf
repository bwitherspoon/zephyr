## CMakeLists.txt
```
# Copyright (c) 2019 Brett Witherspoon
#
# SPDX-License-Identifier: Apache-2.0

cmake_minimum_required(VERSION 3.13.1)

include($ENV{ZEPHYR_BASE}/cmake/app/boilerplate.cmake NO_POLICY_SCOPE)
project(opt3001)

target_sources(app PRIVATE src/main.c)
```

## sample.yaml
```
sample:
  name: OPT3001 Light Sensor
tests:
  test_build:
    harness: sensor
    platform_whitelist: cc1352r1_launchxl cc26x2r1_launchxl
    tags: sensors
    depends_on: i2c
```

## prj.conf
```kconfig
CONFIG_STDOUT_CONSOLE=y
CONFIG_I2C=y
CONFIG_SENSOR=y
CONFIG_OPT3001=y
```

## src/main.c
```c
/*
 * Copyright (c) 2019 Brett Witherspoon
 *
 * SPDX-License-Identifier: Apache-2.0
 */

#include <zephyr.h>
#include <stdio.h>
#include <device.h>
#include <drivers/sensor.h>

void main(void)
{
	struct sensor_value val;

	struct device *dev = device_get_binding(DT_INST_0_TI_OPT3001_LABEL);
	if (dev == NULL) {
		printf("Failed to get device: %s\n", DT_INST_0_TI_OPT3001_LABEL);
		return;
	}

	while (true) {
		if (sensor_sample_fetch(dev) < 0) {
			printf("Failed to fetch sample\n");
			return;
		};

		if (sensor_channel_get(dev, SENSOR_CHAN_LIGHT, &val) < 0) {
			printf("Failed to get channel\n");
			return;
		}

		printf("lux: %.2f\n", sensor_value_to_double(&val));

		k_sleep(K_MSEC(1000));
	}
}
```
