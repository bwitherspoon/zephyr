/*
 * Copyright (c) 2019 Brett Witherspoon
 *
 * SPDX-License-Identifier: Apache-2.0
 */

&spi0 {

	adxl362@0 {
		compatible = "adi,adxl362";
		reg = <0>;
		spi-max-frequency = <2000000>;
		int1-gpios = <&gpio0 18 0>;
		label = "ADXL362";
	};

};
