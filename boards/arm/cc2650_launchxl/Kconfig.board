## boards/arm/cc2650_launchxl/Kconfig.board
```kconfig
# Kconfig - TI CC2650 LaunchPad board
#
# Copyright (c) 2019 Brett Witherspoon
#
# SPDX-License-Identifier: Apache-2.0

config BOARD_CC2650_LAUNCHXL
	bool "TI CC2650 LaunchPad"
	depends on SOC_CC2650
```

## boards/arm/cc2650_launchxl/Kconfig.defconfig
```kconfig
# Kconfig - TI CC2650 LaunchPad board
#
# Copyright (c) 2019 Brett Witherspoon
#
# SPDX-License-Identifier: Apache-2.0

if BOARD_CC2650_LAUNCHXL

config BOARD
	default "cc2650_launchxl"

if SPI

config SPI_0
       default y

endif # SPI

endif # BOARD_CC2650_LAUNCHXL
```

## boards/arm/cc2650_sensortag/cc2650_sensortag_defconfig
```kconfig
#
# Copyright (c) 2019 Brett Witherspoon
#
# SPDX-License-Identifier: Apache-2.0
#

CONFIG_ARM=y
CONFIG_SOC_SERIES_CC13X0_CC26X0=y
CONFIG_SOC_CC2650=y
CONFIG_CORTEX_M_SYSTICK=y
CONFIG_BOARD_CC2650_SENSORTAG=y

CONFIG_CC13X0_CC26X0_BOOTLOADER_ENABLE=y
CONFIG_CC13X0_CC26X0_BOOTLOADER_BACKDOOR_ENABLE=y
CONFIG_CC13X0_CC26X0_BOOTLOADER_BACKDOOR_PIN=4

CONFIG_PINMUX=y
CONFIG_GPIO=y
CONFIG_SERIAL=y

CONFIG_PRINTK=y
CONFIG_CONSOLE=y
CONFIG_UART_CONSOLE=y
```

## dts/bindings/dac/adi,ad5697.yaml
```yaml
# Copyright (c) 2024 Brett Witherspoon
# SPDX-License-Identifier: Apache-2.0

description: Analog Devices 12-Bit 2-channel I2C DAC

compatible: "adi,ad5697"

include: adi,ad56xx-base.yaml
```

## samples/subsys/video/capture_to_lvgl/boards/stm32f746g_disco.conf
```kconfig
#
# SPDX-License-Identifier: Apache-2.0
#

CONFIG_VIDEO_BUFFER_POOL_SZ_MAX=51200
```

## soc/arm/ti_simplelink/cc13x0_cc26x0/Kconfig.defconfig.cc2650
```kconfig
# Kconfig.defconfig.cc2650 - Texas Instruments SimpleLink CC2650
#
# Copyright (c) 2019 Brett Witherspoon
#
# SPDX-License-Identifier: Apache-2.0
#

if SOC_CC2650

config SOC
	string
	default "cc2650"

endif # SOC_CC2650
```

## soc/arm/ti_simplelink/cc13x0_cc26x0/Kconfig.defconfig.series
```kconfig
# Kconfig.defconfig.series - Texas Instruments SimpleLink CC13x2 / CC26x2
#
# Copyright (c) 2019 Brett Witherspoon
#
# SPDX-License-Identifier: Apache-2.0
#

if SOC_SERIES_CC13X0_CC26X0

source "soc/arm/ti_simplelink/cc13x0_cc26x0/Kconfig.defconfig.cc*"

config SOC_SERIES
	string
	default "cc13x0_cc26x0"

config SYS_CLOCK_HW_CYCLES_PER_SEC
	int
	default 48000000

config NUM_IRQS
	int
	default 34

config TI_CCFG_PRESENT
	bool
	default y

if PINMUX

config PINMUX_CC13XX_CC26XX
	default y

endif # PINMUX

if GPIO

config GPIO_CC13XX_CC26XX
	default y

endif # GPIO

if SERIAL

config UART_CC13XX_CC26XX
	default y

endif # SERIAL

if I2C

config I2C_CC13XX_CC26XX
	default y

endif # I2C

endif # SOC_SERIES_CC13X0_CC26X0
```

## soc/arm/ti_simplelink/cc13x0_cc26x0/Kconfig.series
```kconfig
# Kconfig.series - Texas Instruments SimpleLink CC13x0 / CC26x0
#
# Copyright (c) 2019 Brett Witherspoon
#
# SPDX-License-Identifier: Apache-2.0
#

config SOC_SERIES_CC13X0_CC26X0
	bool "TI SimpleLink Family CC13x0 / CC26x0"
	select CPU_CORTEX_M3
	select CPU_CORTEX_M_HAS_SYSTICK
	select SOC_FAMILY_TISIMPLELINK
	help
	  Enable support for TI SimpleLink CC13x0 / CC26x0 SoCs

menuconfig CC13X0_CC26X0_BOOTLOADER_ENABLE
	bool "ROM bootloader"
	depends on SOC_SERIES_CC13X0_CC26X0
	help
	  Enable the serial bootloader which resides in ROM on CC13xx / CC26xx
	  devices.

if CC13X0_CC26X0_BOOTLOADER_ENABLE

config CC13X0_CC26X0_BOOTLOADER_BACKDOOR_ENABLE
	bool "ROM bootloader backdoor"
	help
	  Enable the ROM bootloader backdoor which starts the bootloader if the
	  associated pin is at the correct logic level on reset.

config CC13X0_CC26X0_BOOTLOADER_BACKDOOR_PIN
	int "ROM bootloader backdoor pin"
	depends on CC13X0_CC26X0_BOOTLOADER_BACKDOOR_ENABLE
	range 0 255
	default 255
	help
	  Set the pin that is level checked if the bootloader backdoor is enabled.

config CC13X0_CC26X0_BOOTLOADER_BACKDOOR_LEVEL
	int "ROM bootloader backdoor level"
	depends on CC13X0_CC26X0_BOOTLOADER_BACKDOOR_ENABLE
	range 0 1
	default 0
	help
	  Set the active level of the pin selected for the bootloader backdoor.

endif # CC13X0_CC26X0_BOOTLOADER_ENABLE
```

## soc/arm/ti_simplelink/cc13x0_cc26x0/Kconfig.soc
```kconfig
# Kconfig.soc - Texas Instruments SimpleLink CC26x0
#
# Copyright (c) 2019 Brett Witherspoon
#
# SPDX-License-Identifier: Apache-2.0
#

choice
prompt "TI SimpleLink MCU Selection"
depends on SOC_SERIES_CC13X0_CC26X0

config SOC_CC2650
  bool "CC2650"
  select HAS_CC26X0_SDK

endchoice
```
